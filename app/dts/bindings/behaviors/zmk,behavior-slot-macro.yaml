## app/dts/bindings/zmk,underglow-indicators.yaml
```yaml
# Copyright (c) 2020, The ZMK Contributors
# SPDX-License-Identifier: MIT

description: Underglow indicators (battery, HID locks, layer, BLE, USB).

compatible: "zmk,underglow-indicators"

properties:
  bat-lhs:
    type: array
    required: true
    description: Physical LED indices dedicated to the LH battery bar.
  bat-rhs:
    type: array
    required: true
    description: Physical LED indices dedicated to the RH battery bar.
  capslock:
    type: int
    required: true
  numlock:
    type: int
    required: true
  scrolllock:
    type: int
    required: true
  layer-state:
    type: array
    required: true
    description: LED index per active-layer slot (index 0 = layer 0, etc.).
  ble-state:
    type: array
    required: true
    description: LED index per BLE profile slot.
  usb-state:
    type: int
    required: true
  output-fallback:
    type: int
    required: true
```
